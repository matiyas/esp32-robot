## main/Kconfig.projbuild
```kconfig
menu "Robot Controller Configuration"

    menu "WiFi Settings"
        config ROBOT_WIFI_SSID
            string "Access Point SSID"
            default "ESP32-Robot"
            help
                WiFi Access Point network name (broadcasted by ESP32).

        config ROBOT_WIFI_PASSWORD
            string "Access Point Password"
            default ""
            help
                WiFi Access Point password. Minimum 8 characters for WPA2.
                Leave empty for open network.

        config ROBOT_WIFI_MAX_CONNECTIONS
            int "Maximum client connections"
            default 4
            range 1 10
            help
                Maximum number of clients that can connect to the AP.
    endmenu

    menu "Motor Control"
        config ROBOT_MOTOR_LEFT_IN1
            int "Left Motor IN1 GPIO"
            default 12
            range 0 39
            help
                GPIO pin connected to left motor DRV8833 IN1.

        config ROBOT_MOTOR_LEFT_IN2
            int "Left Motor IN2 GPIO"
            default 13
            range 0 39
            help
                GPIO pin connected to left motor DRV8833 IN2.

        config ROBOT_MOTOR_RIGHT_IN1
            int "Right Motor IN1 GPIO"
            default 14
            range 0 39
            help
                GPIO pin connected to right motor DRV8833 IN1.

        config ROBOT_MOTOR_RIGHT_IN2
            int "Right Motor IN2 GPIO"
            default 15
            range 0 39
            help
                GPIO pin connected to right motor DRV8833 IN2.

        config ROBOT_MOTORS_ENABLE
            int "Motors Enable (PWM) GPIO"
            default 2
            range 0 39
            help
                GPIO pin connected to both DRV8833 EEP pins (shared enable).

        config ROBOT_PWM_FREQUENCY
            int "PWM Frequency (Hz)"
            default 1000
            range 100 10000
            help
                PWM frequency for motor speed control.

        config ROBOT_PWM_RAMP_DURATION_MS
            int "PWM Ramp Duration (ms)"
            default 500
            range 0 2000
            help
                Duration of soft-start PWM ramp to prevent inrush current.

        config ROBOT_PWM_RAMP_STEPS
            int "PWM Ramp Steps"
            default 25
            range 1 100
            help
                Number of steps in PWM soft-start ramp.
    endmenu

    menu "Servo Control"
        config ROBOT_SERVO_GPIO
            int "Servo Signal GPIO"
            default 2
            range 0 39
            help
                GPIO pin connected to SG90 servo signal (steering servo in CAR mode).
                Default GPIO2; avoid GPIO16/17 which are used by PSRAM on the
                ESP32-CAM, and GPIO4 which drives the flash LED.

        config ROBOT_SERVO_MIN_PULSE_US
            int "Minimum Pulse Width (us)"
            default 500
            range 100 1000
            help
                Minimum servo pulse width in microseconds (0 degrees).

        config ROBOT_SERVO_MAX_PULSE_US
            int "Maximum Pulse Width (us)"
            default 2400
            range 2000 3000
            help
                Maximum servo pulse width in microseconds (180 degrees).

        config ROBOT_SERVO_MIN_ANGLE
            int "Minimum Angle"
            default 0
            range 0 90
            help
                Minimum servo angle in degrees.

        config ROBOT_SERVO_MAX_ANGLE
            int "Maximum Angle"
            default 180
            range 90 180
            help
                Maximum servo angle in degrees.

        config ROBOT_SERVO_DEFAULT_ANGLE
            int "Default Angle"
            default 90
            range 0 180
            help
                Default servo position on startup.

        config ROBOT_SERVO_STEP_ANGLE
            int "Step Angle"
            default 10
            range 1 45
            help
                Degrees to move per turret left/right command.

        config ROBOT_SERVO_SMOOTH_STEP
            int "Smooth Step Degrees"
            default 2
            range 1 10
            help
                Degrees per interpolation step for smooth movement.

        config ROBOT_SERVO_SMOOTH_DELAY_MS
            int "Smooth Step Delay (ms)"
            default 15
            range 5 50
            help
                Delay between smooth interpolation steps.
    endmenu

    menu "Safety Settings"
        config ROBOT_MOVEMENT_TIMEOUT_MS
            int "Maximum Movement Duration (ms)"
            default 5000
            range 1000 30000
            help
                Maximum allowed duration for movement commands.

        config ROBOT_TURRET_TIMEOUT_MS
            int "Maximum Turret Duration (ms)"
            default 2000
            range 500 10000
            help
                Maximum allowed duration for turret commands.

        config ROBOT_WATCHDOG_TIMEOUT_S
            int "Watchdog Timeout (seconds)"
            default 10
            range 5 60
            help
                Task watchdog timeout in seconds.
    endmenu

    menu "HTTP Server"
        config ROBOT_HTTP_PORT
            int "HTTP Server Port"
            default 80
            range 1 65535
            help
                Port for the HTTP REST API server.

        config ROBOT_ENABLE_MOCK_MODE
            bool "Enable Mock Mode (no hardware)"
            default n
            help
                Enable mock mode for development without physical hardware.
                All GPIO operations will be simulated with logging.
    endmenu

    menu "RC / CRSF"
        choice ROBOT_KINEMATICS
            prompt "Kinematics mode"
            default ROBOT_KINEMATICS_TANK
            help
                TANK: two motors, skid-steer (original behavior).
                CAR: one drive motor + steering servo, driven by an ELRS/CRSF radio.

            config ROBOT_KINEMATICS_TANK
                bool "Tank (skid-steer)"
            config ROBOT_KINEMATICS_CAR
                bool "Car (drive motor + steering servo)"
        endchoice

        choice ROBOT_DRV8833_MODE
            prompt "DRV8833 drive mode (CAR)"
            default ROBOT_DRV8833_SINGLE
            help
                SINGLE: one DRV8833 channel (~1.5A).
                PARALLEL: both channels paralleled for ~3A. Tie the inputs
                (AIN1+BIN1, AIN2+BIN2) and outputs together externally; the
                firmware drives the same two GPIOs in both modes.

            config ROBOT_DRV8833_SINGLE
                bool "Single channel (~1.5A)"
            config ROBOT_DRV8833_PARALLEL
                bool "Parallel channels (~3A)"
        endchoice

        config ROBOT_CAR_DRIVE_IN1
            int "CAR drive motor IN1 GPIO"
            default 13
            range 0 39
            help
                Drive motor DRV8833 IN1 in CAR mode. GPIO12 is intentionally
                avoided (flash-voltage strapping pin).

        config ROBOT_CAR_DRIVE_IN2
            int "CAR drive motor IN2 GPIO"
            default 14
            range 0 39
            help
                Drive motor DRV8833 IN2 in CAR mode.

        config ROBOT_CRSF_UART_NUM
            int "CRSF UART peripheral"
            default 1
            range 1 2
            help
                Hardware UART used for the CRSF receiver (1 or 2).

        config ROBOT_CRSF_RX_GPIO
            int "CRSF RX GPIO"
            default 15
            range 0 39
            help
                Pin receiving CRSF from the ELRS RX (routed via the GPIO matrix).
                Default GPIO15: a UART input idles high, so its strapping
                behavior is harmless at boot.

        config ROBOT_CRSF_BAUD
            int "CRSF baud rate"
            default 420000
            range 9600 2000000
            help
                CRSF serial baud (8N1, not inverted). ELRS uses 420000.

        config ROBOT_CRSF_CH_STEERING
            int "Steering channel"
            default 1
            range 1 16

        config ROBOT_CRSF_CH_THROTTLE
            int "Throttle channel"
            default 2
            range 1 16

        config ROBOT_CRSF_CH_ARM
            int "Arm channel (0 = always armed)"
            default 5
            range 0 16
            help
                AUX switch channel that arms the motor. 0 disables arm gating.
                When armed the motor only spins after a disarm->arm cycle.

        config ROBOT_CRSF_THROTTLE_DEADBAND
            int "Throttle deadband (ticks)"
            default 20
            range 0 200
            help
                Ticks around stick center mapped to zero throttle.

        config ROBOT_CRSF_THROTTLE_MAX_DUTY
            int "Throttle max duty (%)"
            default 100
            range 1 100
            help
                Motor duty at full throttle stick (speed limit).

        config ROBOT_CRSF_THROTTLE_REVERSE
            bool "Reverse throttle"
            default n

        config ROBOT_CRSF_STEERING_TRIM
            int "Steering center trim (deg)"
            default 0
            range -45 45
            help
                Offset added to the servo center to straighten the wheels.

        config ROBOT_CRSF_STEERING_MAX_ANGLE
            int "Steering max angle (deg)"
            default 45
            range 1 90
            help
                Servo deflection at full steering stick (protects the linkage).

        config ROBOT_CRSF_STEERING_REVERSE
            bool "Reverse steering"
            default n

        config ROBOT_CRSF_FAILSAFE_TIMEOUT_MS
            int "Failsafe timeout (ms)"
            default 500
            range 100 5000
            help
                If no valid CRSF frame arrives within this window the motor is
                stopped and the servo centered.
    endmenu

    menu "Camera Settings"
        config ROBOT_CAMERA_FRAME_SIZE
            int "Camera Frame Size"
            default 10
            range 0 13
            help
                Frame size enum: 6=QVGA(320x240), 10=VGA(640x480), 11=SVGA(800x600), 12=XGA(1024x768)

        config ROBOT_CAMERA_JPEG_QUALITY
            int "JPEG Quality"
            default 12
            range 10 63
            help
                JPEG compression quality. Lower is better quality but larger.

        config ROBOT_CAMERA_FB_COUNT
            int "Frame Buffer Count"
            default 2
            range 1 3
            help
                Number of frame buffers for camera.
    endmenu

endmenu
```
