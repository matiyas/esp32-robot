## sdkconfig.defaults
```kconfig
# ESP32-CAM Robot Controller Default Configuration

# Target ESP32 (AI-Thinker ESP32-CAM)
CONFIG_IDF_TARGET="esp32"

# Flash configuration
CONFIG_ESPTOOLPY_FLASHSIZE_4MB=y
CONFIG_ESPTOOLPY_FLASHMODE_QIO=y

# Partition table
CONFIG_PARTITION_TABLE_CUSTOM=y
CONFIG_PARTITION_TABLE_CUSTOM_FILENAME="partitions.csv"

# PSRAM configuration (ESP32-CAM has 4MB PSRAM)
CONFIG_ESP32_SPIRAM_SUPPORT=y
CONFIG_SPIRAM_TYPE_AUTO=y
CONFIG_SPIRAM_SPEED_80M=y

# Camera support
CONFIG_CAMERA_TASK_PINNED_TO_CORE=0
CONFIG_CAMERA_CORE0_TASK_PRIORITY=2
CONFIG_CAMERA_GRAB_WHEN_EMPTY=y

# HTTP Server
CONFIG_HTTPD_MAX_REQ_HDR_LEN=1024
CONFIG_HTTPD_MAX_URI_LEN=512

# WiFi
CONFIG_ESP_WIFI_STATIC_RX_BUFFER_NUM=16
CONFIG_ESP_WIFI_DYNAMIC_RX_BUFFER_NUM=32
CONFIG_ESP_WIFI_DYNAMIC_TX_BUFFER_NUM=32

# WiFi Access Point
CONFIG_ROBOT_WIFI_SSID="ESP32"
CONFIG_ROBOT_WIFI_PASSWORD="eEspetrzyjsci2a"
CONFIG_ROBOT_WIFI_MAX_CONNECTIONS=4

# Robot HTTP Server
CONFIG_ROBOT_HTTP_PORT=4567

# FreeRTOS
CONFIG_FREERTOS_HZ=1000
CONFIG_FREERTOS_TIMER_TASK_STACK_DEPTH=3072

# Logging
CONFIG_LOG_DEFAULT_LEVEL_INFO=y
CONFIG_LOG_MAXIMUM_LEVEL_DEBUG=y

# Watchdog
CONFIG_ESP_TASK_WDT_TIMEOUT_S=10

# SPIFFS
CONFIG_SPIFFS_MAX_PARTITIONS=1
```
